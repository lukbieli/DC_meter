## main/Kconfig.projbuild
```kconfig
menu "Example configuration"
    config EXAMPLE_SHUNT_RESISTOR_MILLI_OHM
        int "Shunt resistor value in milliohm)"
        default 100
        help
            Shunt resistor value in milliohm. Must not be zero.

    config EXAMPLE_I2C_ADDR
        hex "I2C address of INA219"
        default 0x40
        help
            I2C address of INA219. The default is A1 pin to GND, and A0 pin to
            GND (`INA219_ADDR_GND_GND`, or `0x40`). See available options in
            ina219.h.

    config EXAMPLE_I2C_MASTER_SCL
        int "SCL GPIO Number"
        default 5 if IDF_TARGET_ESP8266
        default 6 if IDF_TARGET_ESP32C3
        default 19 if IDF_TARGET_ESP32 || IDF_TARGET_ESP32S2 || IDF_TARGET_ESP32S3
        default 4 if IDF_TARGET_ESP32H2
        help
            GPIO number for I2C Master clock line.

    config EXAMPLE_I2C_MASTER_SDA
        int "SDA GPIO Number"
        default 4 if IDF_TARGET_ESP8266
        default 5 if IDF_TARGET_ESP32C3
        default 18 if IDF_TARGET_ESP32 || IDF_TARGET_ESP32S2 || IDF_TARGET_ESP32S3
        default 3 if IDF_TARGET_ESP32H2
        help
            GPIO number for I2C Master data line.
            
    choice EXAMPLE_LCD_CONTROLLER
        prompt "LCD controller model"
        default EXAMPLE_LCD_CONTROLLER_SSD1306
        help
            Select LCD controller model

        config EXAMPLE_LCD_CONTROLLER_SSD1306
            bool "SSD1306"

        config EXAMPLE_LCD_CONTROLLER_SH1107
            bool "SH1107"
    endchoice

    if EXAMPLE_LCD_CONTROLLER_SSD1306
        choice EXAMPLE_SSD1306_HEIGHT
            prompt "SSD1306 Height in pixels"
            default EXAMPLE_SSD1306_HEIGHT_64
            help
                Height of the display in pixels. a.k.a vertical resolution

            config EXAMPLE_SSD1306_HEIGHT_64
                bool "64"
            config EXAMPLE_SSD1306_HEIGHT_32
                bool "32"
        endchoice

        config EXAMPLE_SSD1306_HEIGHT
            int
            default 64 if EXAMPLE_SSD1306_HEIGHT_64
            default 32 if EXAMPLE_SSD1306_HEIGHT_32
    endif
endmenu
```
